## fw/sdkconfig.defaults
```kconfig
# ESProbe DAP Firmware - ESP32-C3 Default Configuration

# Flash configuration
CONFIG_ESPTOOLPY_FLASHMODE_DIO=y
CONFIG_ESPTOOLPY_FLASHFREQ_80M=y
CONFIG_ESPTOOLPY_FLASHSIZE_4MB=y

# CPU Frequency
CONFIG_ESP32C3_DEFAULT_CPU_FREQ_160=y

# Compiler optimization for performance
CONFIG_COMPILER_OPTIMIZATION_PERF=y

# Disable Bluetooth to save memory
CONFIG_BT_ENABLED=n

# Wi-Fi optimizations
CONFIG_ESP_WIFI_STATIC_RX_BUFFER_NUM=25
CONFIG_ESP_WIFI_AMPDU_TX_ENABLED=y
CONFIG_ESP_WIFI_TX_BA_WIN=32
CONFIG_ESP_WIFI_AMPDU_RX_ENABLED=y
CONFIG_ESP_WIFI_RX_BA_WIN=32
CONFIG_ESP_WIFI_DYNAMIC_TX_BUFFER=y
CONFIG_ESP_WIFI_DYNAMIC_TX_BUFFER_NUM=64
CONFIG_ESP_WIFI_DYNAMIC_RX_BUFFER_NUM=64
CONFIG_ESP_WIFI_IRAM_OPT=y
CONFIG_ESP_WIFI_RX_IRAM_OPT=y

# LWIP configuration
CONFIG_LWIP_LOCAL_HOSTNAME="esprobe"
CONFIG_LWIP_MAX_SOCKETS=10
CONFIG_LWIP_TCP_HIGH_SPEED_RETRANSMISSION=y
CONFIG_LWIP_TCP_MSS=1440
CONFIG_LWIP_TCP_SND_BUF_DEFAULT=5744
CONFIG_LWIP_TCP_WND_DEFAULT=5744
CONFIG_LWIP_TCPIP_TASK_STACK_SIZE=3072

# mDNS
CONFIG_MDNS_MAX_SERVICES=10

# Disable watchdogs for debugging (can be enabled later)
# CONFIG_ESP_INT_WDT is not set
# CONFIG_ESP_TASK_WDT is not set

# UART ISR in IRAM for low latency
CONFIG_UART_ISR_IN_IRAM=y

# Main task stack
CONFIG_ESP_MAIN_TASK_STACK_SIZE=3584
```
