## fw/main/Kconfig.projbuild
```kconfig
menu "wireless dap config"
    config USE_WEBSOCKET_DAP
        bool "Enable the websocket dap feature"

    menu "WiFi Configuration"
        config WIFI_SSID_1
            string "WiFi SSID 1"
            default "OTA"
        config WIFI_PASS_1
            string "WiFi Password 1"
            default "12345678"

        config WIFI_SSID_2
            string "WiFi SSID 2"
            default "DAP"
        config WIFI_PASS_2
            string "WiFi Password 2"
            default "12345678"
    endmenu

    menu "AP Fallback"
        config USE_AP_FALLBACK
            bool "Enable AP fallback when STA fails"
            default y
            help
                When STA connection fails after the configured number of
                retries, the device switches to AP mode so the host can
                connect directly.

        config AP_FALLBACK_MAX_RETRIES
            int "Max STA retry count before AP fallback"
            default 10
            range 3 100
            depends on USE_AP_FALLBACK

        config AP_SSID_PREFIX
            string "AP SSID prefix"
            default "ESProbe"
            depends on USE_AP_FALLBACK
            help
                The AP SSID will be this prefix followed by the last 2
                bytes of the MAC address, e.g. "ESProbe-A1B2".

        config AP_PASSWORD
            string "AP password (empty for open AP)"
            default ""
            depends on USE_AP_FALLBACK
    endmenu
endmenu
```
